## linux-3.4.x/ralink/Kconfig
```kconfig
menu "Ralink Module"

###########
# Nvram
###########
source "drivers/char/ranvram/Kconfig"

###########
# Debuging
###########
source "drivers/net/rt_rdm/Kconfig"

#############
# Wired
#############
menu "Ralink Wired Ethernet Driver"
source "drivers/net/raeth/Kconfig"
endmenu

#############
# Wireless
#############
menu "Ralink Wireless 802.11 Support"

comment "1st Wireless Interface"

choice
	prompt "Choose 1st Wireless Interface"
	config RT_FIRST_IF_NONE
	bool "None"

	config RT_FIRST_IF_MT7620
	bool "MT7620 APSoC"
	depends on RALINK_MT7620

	config RT_FIRST_IF_MT7610E
	bool "MT7610E PCIe"
	depends on RALINK_MT7621

	config RT_FIRST_IF_MT7612E
	bool "MT7612E PCIe"
	depends on RALINK_MT7621

	config RT_FIRST_IF_MT7602E
	bool "MT7602E PCIe"
	depends on RALINK_MT7621

	config RT_FIRST_IF_MT7603E
	bool "MT7603E PCIe"
	depends on RALINK_MT7621 && !RALINK_MT7620

	config RT_FIRST_IF_MT7615E
	bool "MT7615E PCIe"
	depends on RALINK_MT7621 && !RALINK_MT7620
endchoice

choice
	prompt "Range of 1st Wireless Interface"
	depends on !RT_FIRST_IF_NONE

	config RT_FIRST_IF_RANGE_2GHZ
	bool "2.4 GHz"
	depends on !(RT_FIRST_IF_MT7610E || RT_FIRST_IF_MT7612E)

	config RT_FIRST_IF_RANGE_5GHZ
	bool "5GHz"
	depends on !(RT_FIRST_IF_MT7602E || RT_FIRST_IF_MT7603E || RT_FIRST_IF_MT7620)
endchoice

choice
	prompt "EEPROM Type of 1st Wireless Interface"
	depends on !RT_FIRST_IF_NONE

	config RT_FIRST_IF_EEPROM_FLASH
	bool "FLASH partition"

	config RT_FIRST_IF_EEPROM_EFUSE
	bool "eFUSE on-die"
	depends on !(RT_FIRST_IF_MT7620)

	config RT_FIRST_IF_EEPROM_PROM
	bool "EEPROM chip"
	depends on !(RT_FIRST_IF_MT7620)
endchoice

config  RT_FIRST_IF_RF_OFFSET
	hex "EEPROM FLASH Offset of 1st Wireless Interface"
	depends on RT_FIRST_IF_EEPROM_FLASH
	default 0x40000 if !RT_FIRST_IF_MT7615E
	default 0x0 if RT_FIRST_IF_MT7615E

config  RT_FIRST_CARD
	int
	default 0    if RT_FIRST_IF_NONE
	default 7620 if RT_FIRST_IF_MT7620
	default 7610 if RT_FIRST_IF_MT7610E
	default 7612 if RT_FIRST_IF_MT7612E
	default 7602 if RT_FIRST_IF_MT7602E
	default 7603 if RT_FIRST_IF_MT7603E
	default 7615 if RT_FIRST_IF_MT7615E

config RT_FIRST_CARD_EEPROM
	string
	depends on !RT_FIRST_IF_NONE
	default "prom" if RT_FIRST_IF_EEPROM_PROM
	default "efuse" if RT_FIRST_IF_EEPROM_EFUSE
	default "flash" if RT_FIRST_IF_EEPROM_FLASH

comment "2nd Wireless Interface"

choice
	prompt "Choose 2nd Wireless Interface"
	config RT_SECOND_IF_NONE
	bool "None"

	config RT_SECOND_IF_MT7610E
	bool "MT7610E PCIe"

	config RT_SECOND_IF_MT7612E
	bool "MT7612E PCIe"

	config RT_SECOND_IF_MT7602E
	bool "MT7602E PCIe"

	config RT_SECOND_IF_MT7603E
	bool "MT7603E PCIe"

	config RT_SECOND_IF_MT7615E
	bool "MT7615E PCIe"
endchoice

choice
	prompt "Range of 2nd Wireless Interface"
	depends on !RT_SECOND_IF_NONE

	config RT_SECOND_IF_RANGE_2GHZ
	bool "2.4 GHz"
	depends on !(RT_SECOND_IF_MT7610E)

	config RT_SECOND_IF_RANGE_5GHZ
	bool "5GHz"
	depends on !(RT_SECOND_IF_MT7602E)
endchoice

choice
	prompt "EEPROM Type of 2nd Wireless Interface"
	depends on !(RT_SECOND_IF_NONE)

	config RT_SECOND_IF_EEPROM_FLASH
	bool "FLASH partition"

	config RT_SECOND_IF_EEPROM_EFUSE
	bool "eFUSE on-die"

	config RT_SECOND_IF_EEPROM_PROM
	bool "EEPROM chip"
endchoice

config  RT_SECOND_IF_RF_OFFSET
	hex "EEPROM FLASH Offset of 2nd Wireless Interface"
	depends on RT_SECOND_IF_EEPROM_FLASH
	default 0x48000 if !RT_SECOND_IF_MT7615E
	default 0x8000 if RT_SECOND_IF_MT7615E

config  RT_SECOND_CARD
	int
	default 0    if RT_SECOND_IF_NONE
	default 7610 if RT_SECOND_IF_MT7610E
	default 7612 if RT_SECOND_IF_MT7612E
	default 7602 if RT_SECOND_IF_MT7602E
	default 7603 if RT_SECOND_IF_MT7603E
	default 7615 if RT_SECOND_IF_MT7615E

config RT_SECOND_CARD_EEPROM
	string
	depends on !RT_SECOND_IF_NONE
	default "prom" if RT_SECOND_IF_EEPROM_PROM
	default "efuse" if RT_SECOND_IF_EEPROM_EFUSE
	default "flash" if RT_SECOND_IF_EEPROM_FLASH

comment "Wireless drivers settings"
	depends on (!RT_FIRST_IF_NONE || !RT_SECOND_IF_NONE)

choice
	prompt "Power Design for first radio module"
	depends on !RT_FIRST_IF_NONE
	default RT_FIRST_IF_INTERNAL_PA_INTERNAL_LNA
config  RT_FIRST_IF_INTERNAL_PA_INTERNAL_LNA
	bool "Internal PA and Internal LNA"
config  RT_FIRST_IF_INTERNAL_PA_EXTERNAL_LNA
	bool "Internal PA and External LNA"
config  RT_FIRST_IF_EXTERNAL_PA_EXTERNAL_LNA
	bool "External PA and External LNA"
endchoice

choice
	prompt "Power Design for second radio module"
	depends on !RT_SECOND_IF_NONE
	default AP_RT_SECOND_IF_EXTERNAL_PA_EXTERNAL_LNA
config  RT_SECOND_IF_INTERNAL_PA_INTERNAL_LNA
	bool "Internal PA and Internal LNA"
config  RT_SECOND_IF_INTERNAL_PA_EXTERNAL_LNA
	bool "Internal PA and External LNA"
config  RT_SECOND_IF_EXTERNAL_PA_EXTERNAL_LNA
	bool "External PA and External LNA"
endchoice

config BAND_STEERING
	bool "Band Steering"
	depends on !RT_SECOND_IF_NONE
	default n

config MAX_CLIENTS
	int "Maximum wifi clients more clients - more mem and cpu usage."
	depends on !(RT_SECOND_IF_NONE && RT_FIRST_IF_NONE)
	default 56 if (RT_FIRST_IF_MT7620 || RT_FIRST_IF_MT7602E)
	default 72 if RT_FIRST_IF_MT7603E
	default 96 if RT_FIRST_IF_MT7615E

# per band chips
if (RT_FIRST_IF_MT7610E || RT_SECOND_IF_MT7610E)
    menu "AP MODE MediaTek MT7610E PCIe Wireless Driver"
    source "drivers/net/wireless/ralink/mt7610_ap/Kconfig"
    endmenu
endif

if (RT_FIRST_IF_MT7620 || RT_FIRST_IF_MT7612E || RT_FIRST_IF_MT7602E || RT_SECOND_IF_MT7612E || RT_SECOND_IF_MT7602E)
    menu "AP MODE MediaTek MT7620/MT7602E/MT7612E RBUS/PCIe Wireless Driver"
    source "drivers/net/wireless/ralink/mt76x2_ap/Kconfig"
    source "drivers/net/wireless/ralink/mt76x2_sta/Kconfig"
    endmenu
endif

if (RT_FIRST_IF_MT7603E || RT_SECOND_IF_MT7603E)
    menu "AP MODE MediaTek MT7603E PCIe Wireless driver"
    source "drivers/net/wireless/ralink/mt76x3_ap/Kconfig"
    endmenu
endif

# 7615 support all bands in one
if (RT_FIRST_IF_MT7615E || RT_SECOND_IF_MT7615E)
    menu "AP MODE MediaTek MT7615E PCIe Wireless Driver"
    source "drivers/net/wireless/ralink/mt7615_ap/Kconfig"
    endmenu
endif

endmenu

#######
# NAT
#######
menu "NAT acell mode"
choice
	prompt "Ralink Hardware NAT mode"

config RA_NAT_NONE
	bool "Disable NAT acceleration"

config RA_NAT_HW
	bool "Hardware NAT acceleration"
endchoice

if RA_NAT_HW
source "net/nat/hw_nat/Kconfig"
endif
endmenu

#######
# Fastpath
#######
source "net/nat/bcm_nat/Kconfig"

#######
# HWCRYPTO
#######
menu "Ralink HW Crypto"
source "drivers/net/rt_eip/Kconfig"
endmenu

#######
# DEV
#######
menu "Ralink Devices"
config RT3XXX_EHCI_OHCI
	bool "Ralink USB2 EHCI/OHCI controller support"
	depends on (RALINK_MT7620)
	select USB_ARCH_HAS_OHCI
	select USB_ARCH_HAS_EHCI

config MTK_XHCI
	bool "MediaTek USB3/USB2/USB1.1 xHCI controller support"
	depends on (RALINK_MT7621)
	select USB_ARCH_HAS_XHCI
endmenu

endmenu
```
