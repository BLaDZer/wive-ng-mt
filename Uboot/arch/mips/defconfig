## linux-3.4.x/drivers/char/ranvram/Kconfig
```kconfig
config  KERNEL_NVRAM
	bool 'Kernel NVRAM'
	depends on MTD_RALINK
	default y

config  KERNEL_NVRAM_SPLIT_INIC
	bool 'Different offsets for 2860 and iNIC parametrs database'
	depends on KERNEL_NVRAM && !RT_SECOND_IF_NONE
	default n
```

## linux-3.4.x/drivers/net/wireless/ralink/mt7615_ap/Kconfig
```kconfig
config MT7615_AP
	tristate "Mediatek MT7615 802.11ac AP support"
	select WIRELESS_EXT
	select WEXT_SPY
	select WEXT_PRIV

config MT7615_AP_WDS
	bool "WDS"
	depends on MT7615_AP
	default y

config MT7615_AP_MBSS
	bool "MBSSID"
	depends on MT7615_AP
	default y

config MT7615_AP_NEW_MBSSID_MODE
	bool "New MBSSID MODE"
	depends on MT7615_AP && MT7615_AP_MBSS
	default y

config MT7615_AP_ENHANCE_NEW_MBSSID_MODE
	bool "Enhanced MBSSID mode"
	depends on MT7615_AP_NEW_MBSSID_MODE
	default y

config MT7615_AP_APCLI
	bool "AP-Client Support"
	depends on MT7615_AP
	default y

#config MT7615_AP_APCLI_CERT_SUPPORT
#        bool "AP-Client TGn Cert Support"
#	depends on MT7615_AP
#        depends on MT7615_AP_APCLI
#        default n

#config MT7615_AP_MAC_REPEATER_SUPPORT
#	bool "MAC Repeater Support"
#	depends on MT7615_AP
#	depends on MT7615_AP_APCLI
#	default n

#config MT7615_AP_MWDS
#    bool "Mixed WDS(MWDS)"
#    depends on MT7615_AP
#    select MT7615_AP_APCLI
#    default n

#config  MT7615_AP_AIRPLAY
#	bool "AirPlay support"
#	depends on MT7615_AP
#	depends on MT7615_AP_APCLI
#	default n

config MT7615_AP_MUMIMO_SUPPORT
        bool "MU-MIMO Support"
        select MT7615_AP_MU_RA_SUPPORT
        default y

config MT7615_AP_MU_RA_SUPPORT
  	bool "MU-RGA Support"
  	depends on MT7615_AP_MUMIMO_SUPPORT
        default y

#config  MT7615_AP_DFS
#	bool "DFS support"
#	depends on MT7615_AP
#	default n

config  MT7615_AP_CARRIER
	bool "Carrier Detection support"
	depends on MT7615_AP
	default n

config  MT7615_AP_SMART_CARRIER_SENSE
	bool "Smart Carrier Sense support"
	depends on MT7615_AP
	default y

config  MT7615_AP_IDS
	bool "IDS (Intrusion Detection System) support"
	depends on MT7615_AP
	default y

config MT7615_AP_DOT11R_FT_SUPPORT
	bool "802.11r Fast BSS Transition"
	depends on MT7615_AP
	default y

config MT7615_AP_DOT11K_RRM_SUPPORT
	bool "802.11k Radio Resource Management"
	depends on MT7615_AP
	default y

config  MT7615_AP_EXT_CHANNEL_LIST
	bool "Extension Channel List 802.11d compat"
	depends on MT7615_AP
	default y

config MT7615_AP_80211N_DRAFT3
	bool "802.11n Draft3 (BSS Coexistence)"
	depends on MT7615_AP
	default n

config MT7615_AP_80211W_PMF
	bool "802.11w Protected Management Frames (PMF) support"
	depends on MT7615_AP
	default y

#config MT7615_AP_SNIFFER_SUPPORT
#	bool "SNIFFER"
#	depends on MT7615_AP
#	default n

#config MT7615_AP_CUSTOMIZED_HOSTAPD
#	bool "Customized Hostapd Support"
#	depends on MT7615_AP_CFG80211_SUPPORT
#	default n

#config MT7615_AP_DSCP_QOS_MAP_SUPPORT
#	bool "Dscp Qos Mapping Support"
#	depends on MT7615_AP
#	default n

config MT7615_AP_TXBF_SUPPORT
        bool "Tx Bean Forming Support"
	depends on MT7615_AP
        default y

config MT7615_AP_LLTD
	bool "LLTD (Link Layer Topology Discovery Protocol)"
	depends on MT7615_AP

config  MT7615_AP_SNMP
	bool "Net-SNMP Support"
	depends on MT7615_AP

config MT7615_AP_IGMP_SNOOP
	bool "IGMP snooping (M2U in wireless driver)"
	depends on MT7615_AP
	default n

config MT7615_AP_MCAST_RATE_SPECIFIC
	bool "User specific tx rate of mcast pkt"
	depends on MT7615_AP
	default y

config MT7615_AP_EXT_BUILD_CHANNEL_LIST
	bool "Extension Channel List"
	depends on MT7615_AP
	default y

config MT7615_AP_AUTO_CH_SELECT_ENHANCE
	bool "Auto Channel Selection Enhancement"
	depends on MT7615_AP
	default y

#config MT7615_AP_VOW_SUPPORT
#	bool "MediaAir(VOW) support"
#	depends on MT7615_AP
#	default y

#config MT7615_AP_AIRPLAY_SUPPORT
#	bool "AIRPLAY Support"
#	depends on MT7615_AP
#	default n

#config MT7615_AP_RADIO_LINK_SELECTION
#        bool "RADIO_LINK_SELECTION"
#        depends on MT7615_AP
#        default n

config MT7615_AP_LED_CONTROL_SUPPORT
        bool "LED Control Support"
        default y

config MT7615_AP_GPIO_CONTROL_SUPPORT
	bool "GPIO Control Support"
	depends on MT7615_AP
	default n

config MT7615_AP_RADIUS_ACCOUNTING_SUPPORT
	bool "Radius Accounting Support"
	depends on MT7615_AP
	default y

#config MT7615_AP_ROAMING_ENHANCE_SUPPORT
#	bool "Roaming Enhance Support"
#	depends on MT7615_AP
#	depends on APCLI_SUPPORT
#	default n

#config MT7615_AP_EASY_SETUP_SUPPORT
#	bool "Whole Home Coverage - Easy Setup"
#	depends on MT7615_AP
#	default n

#config MT7615_AP_EASY_MODULE_SUPPORT
#	bool "Whole Home Coverage - Easy Setup Module Support"
#	depends on EASY_SETUP_SUPPORT
#	default n

#config MT7615_AP_EVENT_NOTIFIER_SUPPORT
#	bool "Whole Home Coverage - Event Notifier"
#	depends on MT7615_AP
#	default n

config MT7615_AP_AIR_MONITOR
        bool "Air Monitor"
        depends on MT7615_AP
        default n

config MT7615_AP_WNM_SUPPORT
        bool "802.11v WNM Support"
        depends on MT7615_AP
        default n

config MT7615_AP_STA_FORCE_ROAM_SUPPORT
        bool "Station Force Roam Support"
        depends on MT7615_AP
        default n

config MT7615_AP_NETIF_BLOCK
	bool "NETIF Block"
	depends on MT7615_AP
	default n
	help
	  Support Net interface block while Tx-Sw queue full

#config MT7615_AP_VIDEO_TURBINE
#	bool "Video Turbine support"
#	depends on MT7615_AP
#	default n

config MT7615_AP_LINUX_NET_TXQ_SUPPORT
	bool "NET TX Queue Support"
	default y

config MT7615_AP_DEBUG
	bool "Include Debug messages"
	depends on MT7615_AP
	default n
```

## linux-3.4.x/drivers/net/wireless/ralink/rtpci/mt76x2/os/linux/Kconfig.rlt_wifi_sta
```kconfig
config RLT_STA_SUPPORT
	tristate "MediaTek RLT WiFi STA support"
#	depends on NET_RADIO 
	select WIRELESS_EXT
	select WEXT_SPY
	select WEXT_PRIV

config DOT11Z_TDLS_SUPPORT
   	bool "802.11z TDLS support"
    	depends on RLT_STA_SUPPORT
	default n

config DOT11K_RRM_SUPPORT
       bool "802.11k Radio Resource Management"
       depends on RLT_STA_SUPPORT

config CFG80211_SUPPORT
       bool "CFG80211"
       depends on RLT_STA_SUPPORT
       default n
              
#config RT2860V2_EXT_CHANNEL_LIST
#	bool "Extension Channel List"
#	depends on RLT_STA_SUPPORT

#config STA_AUTO_CH_SELECT_ENHANCE
#	bool "Auto Channel Selection Enhancement"
#	depends on RLT_STA_SUPPORT
```

## linux-3.4.x/drivers/net/wireless/ralink/rtpci/mt76x2_ap/Kconfig
```kconfig
config MT76X2_AP
	tristate "MediaTek MT7620/MT7602E/7612E 802.11n/ac AP Support"
	select WIRELESS_EXT
	select WEXT_SPY
	select WEXT_PRIV

config  MT76X2_AP_LED
	bool "LED support"
	depends on MT76X2_AP
	default y

config  MT76X2_AP_WSC
	bool "WSC (WiFi Simple Config)"
	depends on MT76X2_AP
	default n

config  MT76X2_AP_WSC_V2
	bool "WSC V2 (WiFi Simple Config Version 2)"
	depends on MT76X2_AP
	depends on MT76X2_AP_WSC
	default n

config  MT76X2_AP_WSC_NFC_SUPPORT
	bool "WSC out-of-band (NFC)"
	depends on MT76X2_AP
	depends on MT76X2_AP_WSC
	default n

config  MT76X2_AP_LLTD
	bool "LLTD (Link Layer Topology Discovery Protocol)"
	depends on MT76X2_AP
	default y

config  MT76X2_AP_WDS
	bool "WDS"
	depends on MT76X2_AP
	default y

config  MT76X2_AP_MBSS
	bool "MBSSID"
	depends on MT76X2_AP
	default y

config  MT76X2_AP_MBSS_NEW_MBSSID_MODE
	bool "New MBSSID mode support"
	depends on MT76X2_AP
	depends on MT76X2_AP_MBSS
	default y

config  MT76X2_AP_APCLI
	bool "AP-Client Support"
	depends on MT76X2_AP
	default y

config  MT76X2_AP_APCLI_CERT
	bool "AP-Client TGn Cert support"
	depends on MT76X2_AP
	depends on MT76X2_AP_APCLI
	default n

config  MT76X2_AP_MAC_REPEATER
	bool "MAC Repeater Mode support"
	depends on MT76X2_AP
	depends on MT76X2_AP_APCLI
	default n

config  MT76X2_AP_CON_WPS_SUPPORT
	bool "Concurrent WPS support"
	depends on MT76X2_AP
	depends on MT76X2_AP_APCLI
	depends on MT76X2_AP_WSC_V2
	default n

config  MT76X2_AP_DFS
	bool "DFS support"
	depends on MT76X2_AP
	depends on (RT_FIRST_IF_MT7612E || RT_SECOND_IF_MT7612E)
	default n

config  MT76X2_AP_CARRIER
	bool "Carrier Detection support"
	depends on MT76X2_AP
	default n

config  MT76X2_AP_ED_MONITOR
	bool "Clear-Channel Assessment (CCA) Monitor Support"
	depends on MT76X2_AP
	default n

config  MT76X2_AP_DOT11R_FT_SUPPORT
	bool "802.11r Fast BSS Transition"
	depends on MT76X2_AP
	default y

config  MT76X2_AP_DOT11K_RRM_SUPPORT
	bool "802.11k Radio Resource Management"
	depends on MT76X2_AP
	default y

config  MT76X2_AP_EXT_CHANNEL_LIST
	bool "Extension Channel List 802.11d compat"
	depends on MT76X2_AP
	default y

#config  MT76X2_AP_VIDEO_TURBINE
#	bool "Video Turbine support"
#	depends on MT76X2_AP
#	default n

config  MT76X2_AP_GREENAP
	bool "Green AP mode support"
	depends on MT76X2_AP
	depends on RT_FIRST_IF_MT7620 || RT_FIRST_IF_MT7602E
	default n

config  MT76X2_AP_DLS
	bool "802.11e DLS (Direct-Link Setup) support"
	depends on MT76X2_AP
	default n

config  MT76X2_AP_WAPI
	bool "WAPI Support"
	depends on MT76X2_AP
	default n

config  MT76X2_AP_IDS
	bool "IDS (Intrusion Detection System) support"
	depends on MT76X2_AP
	default y

config  MT76X2_AP_80211N_DRAFT3
	bool "802.11n Draft3 (BSS Coexistence)"
	depends on MT76X2_AP
	default n

config  MT76X2_AP_80211AC_VHT
	bool "802.11ac support"
	depends on MT76X2_AP
	depends on (RT_FIRST_IF_MT7612E || RT_SECOND_IF_MT7612E)
	default y

config  MT76X2_AP_TXBF_SUPPORT
	bool "Tx Beam Forming support"
	depends on MT76X2_AP
	depends on (RT_FIRST_IF_MT7612E || RT_SECOND_IF_MT7612E)
	default n

config  MT76X2_AP_80211W_PMF
	bool "802.11w Protected Management Frames (PMF) support"
	depends on MT76X2_AP
	default n

config  MT76X2_AP_IGMP_SNOOP
	bool "IGMP snooping"
	depends on MT76X2_AP
	default n

config  MT76X2_AP_MCAST_RATE_SPECIFIC
	bool "User specific TX rate of mcast packets"
	depends on MT76X2_AP
	default n

config  MT76X2_AP_NETIF_BLOCK
	bool "NETIF Block"
	depends on MT76X2_AP
	default n
	help
	  Support Net interface block while Tx-Sw queue full

#config  MT76X2_AP_HDR_TRANS
#	bool "Header Translation Rx support"
#	depends on MT76X2_AP

#config  MT76X2_AP_CSO
#	bool "Checksum offload (CSO) support"
#	depends on MT76X2_AP

config  MT76X2_AP_DELAYED_TCP_ACK
	bool "Delayed TCP ACK support"
	depends on MT76X2_AP
	default n

config  MT76X2_AP_SNMP
	bool "Net-SNMP Support"
	depends on MT76X2_AP
	default y

config  MT76X2_AP_SINGLE_SKU
	bool "Single SKU support"
	depends on MT76X2_AP
	default n

config  MT76X2_AP_RTMP_INTERNAL_TX_ALC
	bool "MT7620 TSSI Compensation (Internal TX ALC)"
	depends on MT76X2_AP
	depends on RT_FIRST_IF_MT7620
	default y

config  MT76X2_AP_RTMP_TEMPERATURE_COMPENSATION
	bool "MT7620 Temperature Compensation (External TX ALC)"
	depends on MT76X2_AP
	depends on RT_FIRST_IF_MT7620
	default n

config  MT76X2_AP_READ_MAC_FROM_MTD
	bool "Read and set MAC from MTD/EEPROM"
	depends on MT76X2_AP
	default n

#config  MT76X2_AP_BIG_ENDIAN
#	bool "Big-endian platform support"
#	depends on MT76X2_AP
#	depends on !RT_FIRST_IF_MT7620
#	default n

config  MT76X2_AP_MC_SUPPORT
	bool "Multiple Card support"
	default n
	depends on MT76X2_AP

config  MT76X2_AP_ATE
	bool "Provide ATE testmode commands support"
	depends on MT76X2_AP
	select MT76X2_AP_QA
	default n

config  MT76X2_AP_QA
	bool "Provide QA tool support"
	depends on MT76X2_AP
	depends on MT76X2_AP_ATE
	default y

config  MT76X2_AP_INTERFERENCE_REDUCE
	bool "Enable minimize 802.11 interference effects"
	default y
	depends on MT76X2_AP

config  MT76X2_AP_DBG
	bool "Debug support for AP mode"
	depends on MT76X2_AP
	default n
```

## linux-3.4.x/drivers/net/wireless/ralink/rtpci/mt76x2_sta/Kconfig
```kconfig
config MT76X2_STA
	tristate "MediaTek MT7620/MT7602E/7612E 802.11n/ac STA Support"
	depends on MT76X2_AP
	default n
```

## linux-3.4.x/net/nat/bcm_nat/Kconfig
```kconfig
config BCM_NAT
        bool "Broadcom fastpaths (NAT/ROUTE) support"
        depends on NF_CONNTRACK && NF_NAT
        default y
        help
                This helps packets pass through netfilter faster when a packet
                is an established or reply traffic by NAT/ROUTE/INCOMING.
```
